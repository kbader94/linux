## Documentation/devicetree/bindings/net/lin/linux,sdlin.yaml
```yaml
# SPDX-License-Identifier: (GPL-2.0 OR BSD-2-Clause)
%YAML 1.2
---
$id: http://devicetree.org/schemas/net/lin/linux,sdlin.yaml#
$schema: http://devicetree.org/meta-schemas/core.yaml#

title: Local Interconnect Network (LIN) bus over a UART (serdev)

maintainers:
  - Kyle Bader <kyle.bader94@gmail.com>

description: |
  Describes a LIN bus carried over a UART, attached via serdev at
  driver-model probe time. This is the firmware-described counterpart
  to the runtime ldattach-based sllin driver: where sllin is brought
  up from userspace after boot, sdlin binds the UART for LIN before
  userspace exists, which is required for embedded automotive ECUs
  that must answer bus headers within hundreds of ms of power-on.

  A given UART can be claimed either by a serdev driver (the path
  used here) or by a TTY/userspace consumer, but not both. Choose
  this binding when LIN bring-up timing precludes userspace attach.

  Above the transport, sllin and sdlin share the same kernel
  helpers, so feature support is identical: master role with
  unconditional, sporadic, diagnostic, and event-triggered
  schedule slots, slave-publisher role (subject to UART RX
  latency, see LIN_CAP_PUB_SLAVE in
  include/uapi/linux/lin/netlink.h), and bus wakeup.

  Vendor-specific compatibles for particular LIN nodes attached
  to a UART may chain through this driver by listing
  "linux,sdlin" as a fallback compatible:

      compatible = "acme,lin-rear-light", "linux,sdlin";

  The driver matches on "linux,sdlin"; the vendor-specific
  compatible documents what the node actually is.

properties:
  compatible:
    const: linux,sdlin

  bitrate:
    description: |
      LIN bus bit rate in bits per second. Must fall in the LIN
      spec's [1000, 20000] range. When absent, the driver falls
      back to the UART parent's "current-speed" property if
      present, or to the LIN 1.x classic default of 19200 bps.
    $ref: /schemas/types.yaml#/definitions/uint32
    minimum: 1000
    maximum: 20000

required:
  - compatible

additionalProperties: false

examples:
  - |
    serial {
        current-speed = <19200>;

        lin {
            compatible = "linux,sdlin";
            bitrate = <19200>;
        };
    };
```

## drivers/net/lin/Kconfig
```kconfig
# SPDX-License-Identifier: GPL-2.0-only
#
# Local Interconnect Network (LIN) device drivers
#

config LIN_DEV_HELPERS
	tristate
	depends on LIN
	help
	  Shared driver helpers (lin-dev.ko) for host-side LIN drivers:
	  the device-side skb constructors, the owner-tagged loopback
	  synthesiser, the master schedule engine, and the response cache.
	  Auto-selected by every in-tree LIN driver that drives the bus
	  from the host; users do not set this directly. Modelled on
	  can-dev.

config LIN_DEV_HELPERS_UART
	bool
	depends on LIN_DEV_HELPERS
	help
	  UART byte-protocol layer of lin-dev. Adds the LIN-over-UART
	  wire-format machinery (byte state machine, checksum, PID
	  parity, break_ctl timing, RX parsers, FIFO Control probe)
	  to lin-dev.ko. Auto-selected by sllin and sdlin.

config LIN_VLIN
	tristate "Virtual Local Interconnect Network interface (vlin)"
	depends on LIN
	select LIN_DEV_HELPERS
	help
	  Software-only LIN interface, the LIN analogue of vcan. It has no
	  hardware: the interface is its own bus. A master socket's schedule
	  drives headers, registered publishers supply responses, and every
	  resulting frame is looped back to the sockets bound to the
	  interface. Master schedule execution (unconditional, sporadic, and
	  event-triggered slots, including collision resolution), bus wakeup,
	  and the sleep command are all simulated in software.

	  Create an instance with:

	    ip link add dev vlin0 type vlin

	  This is useful for developing and testing PF_LIN applications and
	  the LIN core without LIN hardware.

	  To compile this driver as a module, choose M here: the module will
	  be called vlin.
```

## net/lin/Kconfig
```kconfig
# SPDX-License-Identifier: GPL-2.0-only
#
# Local Interconnect Network (LIN) network layer core configuration
#

menuconfig LIN
	tristate "LIN bus subsystem support"
	help
	  Local Interconnect Network (LIN) is a low-cost, single-master
	  serial bus widely used in automotive body electronics for
	  subsystems where CAN is oversized — door modules, window lifts,
	  seat controls, and similar. It is specified by ISO 17987.

	  This option enables the PF_LIN protocol family, which provides
	  socket-based access to LIN network interfaces following the same
	  model as SocketCAN (PF_CAN). Select this if you want to build
	  the LIN core; you will also need a driver for your specific
	  LIN controller under the Network device support section.

if LIN

config LIN_RAW
	tristate "Raw LIN Protocol (frame-level access with ID filtering)"
	default y
	help
	  The raw LIN protocol offers access to a LIN bus via the BSD
	  socket API. Applications exchange struct lin_frame with the
	  kernel and configure subscribe filters, publisher ownership,
	  master-role claim, and master schedules via setsockopt(). To
	  send or receive raw LIN frames, use AF_LIN with protocol LIN_RAW.

endif
```
